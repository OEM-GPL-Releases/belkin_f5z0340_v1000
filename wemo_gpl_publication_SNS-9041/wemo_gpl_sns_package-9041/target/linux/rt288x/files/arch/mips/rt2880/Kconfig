## wemo_gpl_publication_SNS-9041/wemo_gpl_sns_package-9041/target/linux/rt288x/files/arch/mips/rt2880/Kconfig
```kconfig
if RALINK_RT2880

choice
        prompt "Soc Hardware Type"
	default RT2880_ASIC

config  RT2880_ASIC
        bool "RT2880-ASIC"
endchoice

endif
#-----------------------------

if RALINK_RT3052

choice
        prompt "Soc Hardware Type"
	default RT3052_ASIC

config  RT3052_ASIC
        bool "RT305x/RT3350-ASIC"
endchoice

config RALINK_RT3350
	bool "Ralink RT3350 chipset"

endif

#---------------------------

if RALINK_RT3352

choice
        prompt "Soc Hardware Type"
	default RT3352_ASIC

config  RT3352_ASIC
	bool "RT3352-ASIC"
	select USB_ARCH_HAS_OHCI
	select USB_ARCH_HAS_EHCI

endchoice

endif

#--------------------------

if RALINK_RT3883

choice
        prompt "Soc Hardware Type"
	default RT3883_ASIC

config  RT3883_ASIC
	bool "RT3883/RT3662-ASIC"
	select USB_ARCH_HAS_OHCI
	select USB_ARCH_HAS_EHCI
endchoice

choice
        prompt "RT3883 PCI architecture"
	default PCIE_PCI_CONCURRENT

config PCIE_PCI_CONCURRENT
        bool "PCIE RC and PCI HOST CONCURRENT"
config PCIE_ONLY
        bool "PCIE RC ONLY"
config PCI_ONLY
        bool "PCI HOST ONLY"
config PCIE_PCI_NONE
        bool "Non-support PCI/PCIe"
endchoice

endif

#---------------------------

if RALINK_RT5350

choice
	prompt "Soc Hardware Type"
	default RT5350_ASIC

config	RT5350_ASIC
	bool "RT5350-ASIC"
	select USB_ARCH_HAS_OHCI
	select USB_ARCH_HAS_EHCI

endchoice

endif

#--------------------------
config FLASH_REMAP_NEED
       bool
       default y if (RALINK_RT2880)
choice
       prompt "DRAM Size"
       default RT2880_DRAM_16M

config RT2880_DRAM_8M
       bool "8M"

config RT2880_DRAM_16M
       bool "16M"

config RT2880_DRAM_32M
       bool "32M"

config RT2880_DRAM_64M
       bool "64M"

config RT2880_DRAM_128M
       bool "128M"

endchoice


choice
       prompt "Flash Type"
       default MTD_ANY_RALINK

config MTD_NOR_RALINK
       bool "NOR"
       depends on  !RALINK_RT3352 && !RALINK_RT5350 && !RALINK_RT6855

config MTD_SPI_RALINK
       bool "SPI"
       depends on  !RALINK_RT2880

config MTD_NAND_RALINK
       bool "NAND"
       depends on  !RALINK_RT3352 && !RALINK_RT2880 && !RALINK_RT5350 && !RALINK_RT6855

config MTD_ANY_RALINK
       bool "ANY (NOR/SPI/NAND)"
       depends on  !RALINK_RT3352 && !RALINK_RT5350

endchoice


choice
       prompt "Flash Size"
       default RT2880_FLASH_4M
#       depends on  FLASH_REMAP_NEED
       depends on  FLASH_REMAP_NEED || DUAL_IMAGE

config RT2880_FLASH_2M
       bool "2M"
       depends on  !DUAL_IMAGE

config RT2880_FLASH_4M
       bool "4M"

config RT2880_FLASH_8M
       bool "8M"

config RT2880_FLASH_16M
       bool "16M"

endchoice


choice
       prompt "Flash partitioning"
       default WEMO_FLASH_OPTION_1
       depends on  MTD_SPI_RALINK

config WEMO_FLASH_OPTION_1
       bool "16MB dual for WeMO legacy"
	help
	  This selects a flash partitioning scheme that is compatible
	  with the orginal WeMO flash paritioning scheme. 
          partitioning dynamically set at boot time.
	         'A' Image:
	    0 - 0x00000000-0x00050000 : uboot
	    1 - 0x00040000-0x00050000 : Factory
	    2 - 0x00050000-0x00150000 : Kernel
	    3 - 0x00150000-0xXXXXXXXX : Rootfs
	    4 - 0xXXXXXXXX-0x007c0000 : rootfs_data
	    5 - 0x00fe0000-0x00ff0000 : Nvram
	    6 - 0x00ff0000-0x01000000 : User_Factory
	    7 - 0x00040000-0x00050000 : Factory
	    8 - 0x00f30000-0x00fd0000 : Belkin_settings
	    9 - 0x00030000-0x00040000 : Uboot_env

	         'B' Image:
	    0 - 0x00000000-0x00050000 : uboot
	    1 - 0x00040000-0x00050000 : Factory
	    2 - 0x007c0000-0x008c0000 : Kernel
	    3 - 0x008c0000-0xXXXXXXXX : Rootfs
	    4 - 0xXXXXXXXX-0x00f30000 : rootfs_data
	    5 - 0x00fe0000-0x00ff0000 : Nvram
	    6 - 0x00ff0000-0x01000000 : User_Factory
	    7 - 0x00040000-0x00050000 : Factory
	    8 - 0x00f30000-0x00fd0000 : Belkin_settings
	    9 - 0x00030000-0x00040000 : Uboot_env

config WEMO_FLASH_OPTION_2
       bool "16MB dual for WEMO Link"
	help
        Partition laylout:
	  MTD 0         FLASH               0000000      1000000
	  MTD 1         UBOOT               0000000      0030000
  	  MTD 2         UBOOT_ENV           0030000      0040000
  	  MTD 3         FACTORY             0040000      0050000
  	  MTD 4         KERNEL_1            0050000      0150000
  	  MTD 5         ROOTFS_1            0150000      0750000
  	  MTD 6         KERNEL_2            0750000      0850000
  	  MTD 7         ROOTFS_2            0850000      0E50000
  	  MTD 8         BELKIN_SETTINGS     0E50000      0FE0000
  	  MTD 9         NVRAM               0FE0000      0FF0000
  	  MTD 10        USER_FACTORY        0FF0000      1000000
  	  MTD 11        FIRMWARE_1          0050000      0750000
  	  MTD 12        FIRMWARE_2          0750000      0E50000
	    

config WEMO_FLASH_SMART
	bool "WeMo Smart module flash layout"
	help
	Partition layout
	dev:    size   erasesize  name
	mtd0: 00050000 00010000 uboot
	mtd1: 00770000 00010000 A - Kernel and Rootfs
	mtd2: 00670000 00010000 A - Rootfs
	mtd3: 00770000 00010000 B - Kernel and Rootfs
	mtd4: 00670000 00010000 B - Rootfs
	mtd5: 00010000 00010000 Nvram
	mtd6: 00010000 00010000 User_Factory
	mtd7: 00010000 00010000 Factory
	mtd8: 000a0000 00010000 rootfs_data
	mtd9: 00010000 00010000 Uboot_env

endchoice

config RF_OFFSET
       hex 'Partition Factory offset'
       default 0x00040000
       depends on WEMO_FLASH_OPTION_1 || WEMO_FLASH_OPTION_2 || WEMO_FLASH_SMART

config NVRAM_OFFSET
       hex 'Partition NVRAM offset'
       default 0x00fe0000
       depends on WEMO_FLASH_OPTION_1 || WEMO_FLASH_OPTION_2 || WEMO_FLASH_SMART

config  DUAL_IMAGE
	bool 'Dual Image'

config  KERNEL_NVRAM
	bool 'Kernel NVRAM'
	default n

#config  RT2880_FLASH_32M
#        bool "Flash Size 32MB Support"
#	depends on (RALINK_RT3052_MP2 || RALINK_RT3350) && !MTD_SPI_RALINK
#	select MTD_CONCAT if RT2880_FLASH_32M

config  RALINK_RAM_SIZE
	int
	default 8 if RT2880_DRAM_8M
	default 16 if RT2880_DRAM_16M
	default 32 if RT2880_DRAM_32M
	default 64 if RT2880_DRAM_64M
	default 128 if RT2880_DRAM_128M

config MTD_PHYSMAP_START
       hex
       default 0xBFC00000 if RT2880_FLASH_2M && !RALINK_RT3052
       default 0xBFC00000 if RT2880_FLASH_4M && !RALINK_RT3052
       default 0xBF400000 if RT2880_FLASH_8M && !RALINK_RT3052
       default 0xBEC00000 if RT2880_FLASH_16M && !RALINK_RT3052
       default 0xBF000000 if RT2880_FLASH_32M && !RALINK_RT3052
       default 0xBF000000 if !FLASH_REMAP_NEED && RALINK_RT3052
       default 0x1C000000 if !FLASH_REMAP_NEED && RALINK_RT3352
       default 0x1C000000 if !FLASH_REMAP_NEED && RALINK_RT5350
       default 0x1C000000 if !FLASH_REMAP_NEED && RALINK_RT3883

config MTD_PHYSMAP_LEN
       hex
       default 0x200000 if RT2880_FLASH_2M
       default 0x400000 if RT2880_FLASH_4M
       default 0x800000 if RT2880_FLASH_8M
       default 0x1000000 if RT2880_FLASH_16M
       default 0x2000000 if RT2880_FLASH_32M
       default 0x1000000 if !FLASH_REMAP_NEED

config MTD_PHYSMAP_BUSWIDTH
       int
       default 2

choice
	prompt "Root File System Type"
	default RT2880_ROOTFS_IN_RAM

config  RT2880_ROOTFS_IN_RAM
        bool "RootFS_in_RAM"
	select BLK_DEV_INITRD
	select BLK_DEV_RAM

config  RT2880_ROOTFS_IN_FLASH
        bool "RootFS_in_FLASH"
endchoice

config BLK_DEV_RAM_SIZE
	int 'Default RAM disk size'
	default 8192
	depends on RT2880_ROOTFS_IN_RAM

config	LZMARAMFS
	bool "Compress ramdisk by lzma instead of gzip"
	depends on RT2880_ROOTFS_IN_RAM

config ROOTFS_IN_FLASH_NO_PADDING
	bool 'No Padding between Kernel and RootFS'
	default n
	depends on RT2880_ROOTFS_IN_FLASH && !RT2880_FLASH_32M && !DUAL_IMAGE

config MTD_KERNEL_PART_SIZ
	hex 'MTD Kernel Partition Size (Unit:Bytes)'
	default 0xD0000
	depends on RT2880_ROOTFS_IN_FLASH && !ROOTFS_IN_FLASH_NO_PADDING

config  RALINK_TIMER
	tristate 'Ralink WatchDog'

config  RALINK_TIMER_WDG
        bool "Ralink WatchDog Timer"
        depends on RALINK_TIMER

config  RALINK_TIMER_WDG_RESET_OUTPUT
        bool "Ralink WatchDog Reset Output"
        depends on RALINK_TIMER_WDG

config  RALINK_WDG_TIMER
        int "WatchDog Timer (Unit:1Sec, Max=30Sec)"
        default 10
        depends on RALINK_TIMER_WDG

config  RALINK_WDG_REFRESH_INTERVAL
        int "WatchDog Refresh Interval (Unit:1Sec, Max=30Sec)"
        default 4
        depends on RALINK_TIMER_WDG

config  RALINK_TIMER_DFS
        bool "Ralink DFS Timer"

config RALINK_EXTERNAL_TIMER
	bool "Ralink External Timer"
	depends on RALINK_RT3352 || RALINK_RT5350 || RALINK_RT6855
```

## wemo_gpl_publication_SNS-9041/wemo_gpl_sns_package-9041/target/linux/rt288x/files/ralink/Kconfig
```kconfig
menu "Ralink Module"

config RTDEV_USB
bool
default y if RT305x_INIC_USB || RT3572_AP || RT5572_AP

config RTDEV_MII
bool
default y if RT2880v2_INIC_MII || RT305x_INIC_MII

config RTDEV_PCI
bool
default y if RT2880v2_INIC_PCI || RT3090_AP || RT5392_AP

config  UNIQUE_WPS
	bool "Unique WPS for Concurrent AP"
        depends on RT2860V2_AP_WSC
        depends on RT3090_AP_WSC || RT3572_AP_WSC || RT5392_AP_WSC || RT5572_AP_WSC
	default n
#######
# USB
#######
source "drivers/usb/dwc_otg/Kconfig"

#######
# NAT
#######
choice
prompt "Ralink NAT Type"


config  RA_NAT_NONE
bool "None"
config  RA_NAT_HW
bool "Hardware"
depends on !RALINK_RT5350
endchoice

endmenu
```
